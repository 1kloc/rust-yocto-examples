## yocto/meta-rust-examples/conf/layer.conf
```bitbake
# We have a conf and classes directory, add to BBPATH
BBPATH .= ":${LAYERDIR}"

# We have recipes-* directories, add to BBFILES
BBFILES += "${LAYERDIR}/recipes-*/*/*.bb \
            ${LAYERDIR}/recipes-*/*/*.bbappend"

BBFILE_COLLECTIONS += "meta-rust-examples"
BBFILE_PATTERN_meta-rust-examples = "^${LAYERDIR}/"
BBFILE_PRIORITY_meta-rust-examples = "8"
```
